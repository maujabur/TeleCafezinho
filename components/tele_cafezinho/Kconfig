## components/tele_cafezinho/Kconfig
```kconfig
menu "TeleCafezinho Domain Config"

config TELE_CAFEZINHO_DEFAULT_GROUP
    string "Default group"
    default "default"
    help
        Grupo inicial usado pelo componente TeleCafezinho. Pode ser alterado
        em runtime via tele_config/MQTT e persistido em NVS.

config TELE_CAFEZINHO_DEFAULT_SIGNAL_SOURCE
    string "Default signal source"
    default "gpio"
    help
        Fonte inicial do sinal local. A primeira fase suporta "gpio".

config TELE_CAFEZINHO_DEFAULT_GPIO_NUM
    int "Default signal GPIO number"
    range -1 48
    default -1
    help
        GPIO inicial usada como entrada do sinal local. Use -1 para deixar a
        entrada GPIO desabilitada ate configuracao runtime.

config TELE_CAFEZINHO_DEFAULT_GPIO_ACTIVE_LEVEL
    int "Default GPIO active level (1=high, 0=low)"
    range 0 1
    default 1
    help
        Nivel logico que representa sinal local ativo.

config TELE_CAFEZINHO_DEFAULT_GPIO_DEBOUNCE_MS
    int "Default GPIO debounce time (ms)"
    range 20 5000
    default 150
    help
        Tempo minimo em estado estavel antes de aceitar uma mudanca de GPIO.

config TELE_CAFEZINHO_DEFAULT_SIGNAL_TTL_S
    int "Default shared signal TTL (seconds)"
    range 2 3600
    default 20
    help
        Tempo que um peer remoto permanece ativo sem receber novo publish.

config TELE_CAFEZINHO_DEFAULT_SIGNAL_PUBLISH_INTERVAL_S
    int "Default active republish interval (seconds)"
    range 1 3600
    default 5
    help
        Intervalo de republicacao enquanto o sinal local estiver ativo.
        Deve ser menor que o TTL configurado.

config TELE_CAFEZINHO_MAX_PEERS
    int "Maximum active peer cache entries"
    range 1 64
    default 16
    help
        Tamanho maximo do cache fixo de peers remotos.

endmenu
```

## sdkconfig.defaults
```kconfig
CONFIG_IDF_TARGET="esp32s3"
CONFIG_IDF_TARGET_ESP32S3=y
CONFIG_ESPTOOLPY_FLASHSIZE_8MB=y
CONFIG_PARTITION_TABLE_CUSTOM=y
CONFIG_PARTITION_TABLE_CUSTOM_FILENAME="partitions.csv"
CONFIG_ESP_CONSOLE_USB_SERIAL_JTAG=y
CONFIG_ESP_CONSOLE_USB_SERIAL_JTAG_ENABLED=y
# CONFIG_ESP_CONSOLE_UART_DEFAULT is not set
CONFIG_ESP_CONSOLE_SECONDARY_NONE=y

# Defaults seguros para o exemplo: compila o app completo sem depender de broker,
# credenciais reais, GPIO de LED ou shutdown de bateria.
# CONFIG_STATUS_LED_ENABLED is not set
# CONFIG_MQTT_PRESENCE_ENABLED is not set
# CONFIG_VBAT_MONITOR_ENABLED is not set
# CONFIG_VBAT_SHUTDOWN_ENABLED is not set
# CONFIG_POWER_GOOD_GPIO_ENABLED is not set
# CONFIG_TELE_CA_UPDATER_BOOT_ENABLED is not set

CONFIG_SPIRAM=y
CONFIG_SPIRAM_MODE_OCT=y
CONFIG_SPIRAM_TYPE_AUTO=y
CONFIG_SPIRAM_SPEED_40M=y
CONFIG_SPIRAM_BOOT_INIT=y
CONFIG_SPIRAM_USE_MALLOC=y
CONFIG_SPIRAM_MALLOC_ALWAYSINTERNAL=16384
CONFIG_SPIRAM_MALLOC_RESERVE_INTERNAL=32768
CONFIG_SPIRAM_TRY_ALLOCATE_WIFI_LWIP=y
CONFIG_NVS_ALLOCATE_CACHE_IN_SPIRAM=y

CONFIG_WIFI_PROVISIONING_SSID="TeleSystem"
CONFIG_WIFI_MODEM_SLEEP=y
CONFIG_WIFI_MULTI_NETWORK_CREDENTIALS=y
CONFIG_WIFI_STA_MAX_RETRY=3
CONFIG_WIFI_APSTA_POLICY=1
CONFIG_WIFI_APSTA_GRACE_PERIOD_S=600

CONFIG_BOOT_WIFI_CONFIG_BUTTON_GPIO=3
CONFIG_BOOT_WIFI_CONFIG_BUTTON_ACTIVE_LEVEL=1
CONFIG_BOOT_WIFI_CONFIG_BUTTON_SETTLE_MS=20
CONFIG_BOOT_WIFI_CONFIG_BUTTON_SAMPLE_COUNT=5
CONFIG_BOOT_WIFI_CONFIG_BUTTON_SAMPLE_INTERVAL_MS=10

CONFIG_TIME_SYNC_ENABLED=y
CONFIG_TIME_SYNC_TIMEZONE="<-03>3"
CONFIG_TIME_SYNC_MIN_VALID_YEAR=2024
CONFIG_TIME_SYNC_RETRY_ATTEMPTS=3
CONFIG_TIME_SYNC_WAIT_PER_ATTEMPT_MS=5000
CONFIG_TIME_SYNC_RETRY_DELAY_MS=60000
CONFIG_TIME_SYNC_IDLE_DELAY_MS=10000
CONFIG_TIME_SYNC_SERVER_0="pool.ntp.org"
CONFIG_TIME_SYNC_SERVER_1="time.google.com"
CONFIG_TIME_SYNC_SERVER_2="time.cloudflare.com"

# CONFIG_TELE_PORTAL_LOGS_ENABLE_ENDPOINT is not set
# CONFIG_WEB_PORTAL_EXPOSE_NETWORK_IDENTIFIERS is not set
# CONFIG_WEB_PORTAL_DETAILED_HTTP_ERRORS is not set

# Otimizacoes conservadoras de flash para o perfil padrao.
CONFIG_COMPILER_OPTIMIZATION_SIZE=y
CONFIG_BOOTLOADER_COMPILER_OPTIMIZATION_SIZE=y
CONFIG_BOOTLOADER_LOG_LEVEL_WARN=y
CONFIG_BOOTLOADER_LOG_LEVEL=2
CONFIG_LOG_DEFAULT_LEVEL_WARN=y
CONFIG_LOG_DEFAULT_LEVEL=2
CONFIG_LOG_MAXIMUM_EQUALS_DEFAULT=y
CONFIG_MBEDTLS_CERTIFICATE_BUNDLE_DEFAULT_CMN=y
# CONFIG_MBEDTLS_CERTIFICATE_BUNDLE_DEFAULT_FULL is not set
CONFIG_MBEDTLS_CERTIFICATE_BUNDLE_MAX_CERTS=50
# CONFIG_MBEDTLS_ERROR_STRINGS is not set
# CONFIG_MBEDTLS_SELF_TEST is not set
# CONFIG_MBEDTLS_PEM_WRITE_C is not set
# CONFIG_MBEDTLS_X509_CRL_PARSE_C is not set
# CONFIG_MBEDTLS_X509_CSR_PARSE_C is not set
# CONFIG_MBEDTLS_SSL_PROTO_TLS1_3 is not set
CONFIG_MBEDTLS_PK_WRITE_C=y
# CONFIG_MBEDTLS_DEBUG is not set

CONFIG_ESP_MAIN_TASK_STACK_SIZE=6144
CONFIG_ESP_SYSTEM_EVENT_TASK_STACK_SIZE=4096
```
